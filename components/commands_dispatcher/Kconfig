## components/commands_dispatcher/Kconfig
```kconfig
menu "Commands Dispatcher"

    config COMMANDS_DISPATCHER_QUEUE_SIZE
        int "Commands Dispatcher Queue Size"
        default 10
        range 1 50

    config COMMANDS_DISPATCHER_TASK_STACK_SIZE
        int "Commands Dispatcher Task Stack Size"
        default 4096

    config COMMANDS_DISPATCHER_TASK_PRIORITY
        int "Commands Dispatcher Task Priority"
        default 5

    config COMMANDS_DISPATCHER_TASK_NAME
        string "Commands Dispatcher Task Name"
        default "COMMANDS_DISPATCHER_NAME"

    config COMMANDS_DISPATCHER_MAX_HANDLERS
        int "Max number of command handlers"
        default 5
        range 1 10

    config COMMANDS_DISPATCHER_COMPONENT_ID
        int "Commands Dispatcher Component ID"
        default 7
        help
            Unique identifier for the Commands Dispatcher used by the health monitor.

    config COMMANDS_DISPATCHER_HEARTBEAT_TIMEOUT_MS
        int "Commands Dispatcher Heartbeat Timeout (ms)"
        default 10000
        help
            Maximum time between heartbeats for the Commands Dispatcher task.

endmenu
```

## components/debug_console/Kconfig
```kconfig
menu "Debug Console Configuration"


    config DEBUG_CONSOLE_TASK_STACK_SIZE
        int "Debug Console Task Stack Size"
        default 4096
        help
            Stack size for the Debug Console task. Adjust this value based on the expected workload and memory constraints.

    config DEBUG_CONSOLE_TASK_PRIORITY
        int "Debug Console Task Priority"
        default 2
        help
            Priority for the Debug Console task. Higher values indicate higher priority. Adjust this based on your application's needs.

    config DEBUG_CONSOLE_TASK_NAME
        string "Debug Console Task Name"
        default "debug_console_task"
        help
            Name for the Debug Console task. This is used for debugging and monitoring purposes.

    config DEBUG_CONSOLE_MAX_COMMAND_LENGTH
        int "Debug Console Max Command Length"
        default 256
        help
            Maximum length of commands that can be entered into the Debug Console. Adjust this based on the expected command complexity.

   config DEBUG_CONSOLE_MAX_ARGUMENTS
        int "Debug Console Max Arguments"
        default 8
        help
            Maximum number of arguments that can be passed to a command in the Debug Console. Adjust this based on the expected command complexity.

   config DEBUG_CONSOLE_MAX_REGISTERED_COMMANDS
       int "Debug Console Max Registered Commands"
       default 20
       help
           Maximum number of commands that can be registered with the Debug Console. Adjust this based on the expected number of commands in your application.
endmenu
```

## components/device_manager/Kconfig
```kconfig
menu "Device Manager Configuration"

    config DEVICE_MANAGER_COMPONENT_ID
        int "Device Manager Component ID"
        default 1
        help
            Unique identifier for the Device Manager component. This ID is used in communication protocols
            to identify messages originating from the Device Manager.

    config DEVICE_MANAGER_HEARTBEAT_TIMEOUT_MS
        int "Device Manager Heartbeat Interval (ms)"
        default 5000
        help
            Interval in milliseconds at which the Device Manager sends heartbeat messages to indicate it is alive.

    config DEVICE_MANAGER_MODBUS_UART_NUMBER
        int "Modbus UART Number"
        default 2
        help
            UART number used for Modbus communication. This should correspond to the UART peripheral
            configured in your hardware setup.

    config DEVICE_MANAGER_MAX_DEVICES
        int "Maximum number of devices"
        default 32
        help
            Maximum number of devices that can be registered with the Device Manager.
            This limits the size of the internal device registry and affects memory usage.

    config DEVICE_MANAGER_MODBUS_TX_PIN
        int "Modbus TX Pin"
        default 27
        help
            GPIO pin number used for Modbus transmission (TX). This pin is used to send data to Modbus devices.

    config DEVICE_MANAGER_MODBUS_RX_PIN
        int "Modbus RX Pin"
        default 26
        help
            GPIO pin number used for Modbus reception (RX). This pin is used to receive data
            from Modbus devices.

    config DEVICE_MANAGER_DE_PIN
        int "Modbus DE Pin"
        default 25
        help
            GPIO pin number used for Modbus Driver Enable (DE). This pin is used to control
            the direction of data flow in RS-485 communication.

    config DEVICE_MANAGER_MODBUS_BAUD_RATE
        int "Modbus Baud Rate"
        default 9600
        help
            Baud rate for Modbus communication. Common values are 9600, 19200, and 38400.

    config DEVICE_MANAGER_TASK_STACK_SIZE
        int "Device Manager Task Stack Size"
        default 4096
        help
            Stack size for the Device Manager task. Adjust this value based on the expected workload and memory constraints.

    config DEVICE_MANAGER_TASK_PRIORITY
        int "Device Manager Task Priority"
        default 5
        help
            Priority for the Device Manager task. Higher values indicate higher priority. Adjust this based on your application's needs.

    config DEVICE_MANAGER_TASK_NAME
        string "Device Manager Task Name"
        default "device_manager_task"
        help
            Name for the Device Manager task. This is used for debugging and monitoring purposes.

    config DEVICE_MANAGER_UPDATE_INTERVAL_MS
        int "Device Manager Update Interval (ms)"
        default 1000
        help
            Interval in milliseconds for the Device Manager to update device statuses and perform periodic tasks.
endmenu
```

## components/error_manager/Kconfig
```kconfig
menu "Error Manager"

    config ERROR_MANGER_MAX_MODULES
        int "Max number of modules tracked"
        default 10

endmenu
```

## components/event_manager/Kconfig
```kconfig
menu "Event Manager"
    
    config EVENT_MANAGER_QUEUE_SIZE
        int "Event queue size"
        default 32
    
    config EVENT_MANAGER_TASK_STACK_SIZE
        int "Event manager task stack size"
        default 4096

    config EVENT_MANAGER_TASK_PRIORITY
        int "Event manager task priority"
        default 5

    config EVENT_MANAGER_TASK_NAME
        string "Event manager task name"
        default "event_manager_task"

endmenu
```

## components/health_monitor/Kconfig
```kconfig
menu "Health Monitor Config"
    
    config HEARTH_BEAT_COUNT
        int "Number of components to monitor for heartbeat"
        default 5
    
    config HEALTH_MONITOR_TASK_STACK_SIZE
        int "Health monitor task stack size"
        default 4096
    
    config HEALTH_MONITOR_TASK_PRIORITY
        int "Health monitor task priority"
        default 6 
    
    config HEALTH_MONITOR_TASK_NAME
        string "Health monitor task name"
        default "health_monitor_task"

    config HEALTH_MONITOR_CHECK_INTERVAL_MS
        int "Health monitor check interval in milliseconds"
        default 2000

    config HEALTH_MONITOR_TEMP_MONITOR_MAX_MISSES
        int "Health monitor temp monitor max misses count"
        default 2

    config HEALTH_MONITOR_TEMP_MONITOR_MAX_SILENCE_MS
        int "Health monitor temp monitor max silence interval in ms"
        default 2000

    config HEALTH_MONITOR_TEMP_PROCESSOR_MAX_MISSES
        int "Health monitor temp processor max misses count"
        default 2

    config HEALTH_MONITOR_TEMP_PROCESSOR_MAX_SILENCE_MS
        int "Health monitor temp processor max silence interval in ms"
        default 2000

    config HEALTH_MONITOR_HEATER_CONTROLLER_MAX_MISSES
        int "Health monitor heater controller max misses count"
        default 2

    config HEALTH_MONITOR_HEATER_CONTROLLER_MAX_SILENCE_MS
        int "Health monitor heater controller max silence interval in ms"
        default 2000

    config HEALTH_MONITOR_COORDINATOR_MAX_MISSES
        int "Health monitor coordinator max misses count"
        default 2

    config HEALTH_MONITOR_COORDINATOR_MAX_SILENCE_MS
        int "Health monitor coordinator max silence interval in ms"
        default 2000

endmenu
```

## components/logger_component/Kconfig
```kconfig
menu "Logging"

    config LOG_TASK_STACK_SIZE
        int "Logging task stack size"
        default 4096

    config LOG_TASK_PRIORITY
        int "Logging task priority"
        default 4

    config LOG_TASK_NAME
        string "Logging task name"
        default "LOG_TASK"

    config LOG_ENABLE
        bool "Enable logging"
        default y

    config LOG_LEVEL
        int "Log level (0=ERROR ... 4=VERBOSE)"
        default 4
        range 0 4

    config LOG_QUEUE_SIZE
        int "Queue size"
        default 16

    config LOG_MAX_MESSAGE_LENGTH
        int "Max message length"
        default 265

endmenu
```

## components/modbus_master/src/Kconfig
```kconfig
menu "Device Manager Configuration"

    config DEVICE_MANAGER_MAX_DEVICES
        int "Maximum number of devices"
        default 16
        help
            Maximum number of devices that can be registered with the Device Manager.
            This limits the size of the internal device registry and affects memory usage.
endmenu
```

## components/modbus_temp_monitor/Kconfig
```kconfig
menu "MODBUS Temperature Monitor (MS9024)"

    config MODBUS_TEMP_ENABLED
        bool "Enable MODBUS RTU temperature sensor (MS9024)"
        default n
        help
            Enable reading temperature from an MS9024 MODBUS RTU transmitter
            connected via RS485. When enabled, this replaces the SPI-based
            MAX31865 temperature monitor.

    if MODBUS_TEMP_ENABLED

    config MODBUS_TEMP_RS485_TX_PIN
        int "RS485 TX GPIO pin"
        default 27

    config MODBUS_TEMP_RS485_RX_PIN
        int "RS485 RX GPIO pin"
        default 26

    config MODBUS_TEMP_RS485_DE_PIN
        int "RS485 DE (direction enable) GPIO pin"
        default 25
        help
            Direction-enable pin for the RS485 transceiver.
            NOTE: Default 25 conflicts with CONFIG_HEATER_CONTROLLER_GPIO.
            If using MODBUS, change heater GPIO to 22 in Heater Controller menu.

    config MODBUS_TEMP_UART_PORT
        int "UART port number (0-2)"
        default 2
        range 0 2
        help
            UART0 = console, UART1 = Nextion HMI, UART2 = free for RS485.

    config MODBUS_TEMP_SLAVE_ADDR
        int "MS9024 MODBUS slave address"
        default 1
        range 1 247

    config MODBUS_TEMP_BAUD_RATE
        int "MODBUS baud rate"
        default 9600

    config MODBUS_TEMP_PV_REGISTER
        int "PV (temperature) register address"
        default 728
        help
            MS9024 register that holds the measured process value (temperature).
            728 = IEEE754 float at RAM register 216 + 512.
            Uses MODBUS function code 03 (read holding registers), 2 registers.

    config MODBUS_TEMP_SENSOR_TYPE
        int "Desired MS9024 sensor type (SENS register)"
        default 16
        range 0 24
        help
            The sensor type code to configure on the MS9024 at startup.
            If the MS9024's SENS register differs, firmware will auto-correct it.
            Common values for Pt100:
              16 = Pt100 a=0.003851 (EN 60751 / IEC 751)
              20 = Pt100 a=0.003920 (JIS C 1604)
              21 = Pt100 a=0.003910 (ITS-90 / Callendar-Van Dusen)
            Other RTD types:
              14 = Pt10 385,  15 = Pt50 385,  17 = Pt200 385
              18 = Pt500 385, 19 = Pt1000 385

    config MODBUS_TEMP_WIRE_MODE
        int "RTD wiring mode (2, 3, or 4-wire)"
        default 4
        range 2 4
        help
            The wiring mode for the RTD probe connected to the MS9024.
            If different from the MS9024's current setting, firmware will
            auto-correct it at startup.
              2 = 2-wire (terminals 1 and 4 only)
              3 = 3-wire (terminals 1, 2, and 4)
              4 = 4-wire (terminals 1, 2, 3, and 4)
            TIP: Try 2-wire mode if 4-wire gives wrong readings — useful
            for diagnosing 4-wire measurement circuit issues.

    config MODBUS_TEMP_READ_INTERVAL_MS
        int "Temperature read interval (ms)"
        default 1000
        range 200 10000

    config MODBUS_TEMP_RESPONSE_TIMEOUT_MS
        int "MODBUS response timeout (ms)"
        default 500
        range 100 5000
        help
            How long to wait for a response from the MS9024 after sending
            a MODBUS request. Increase if you see timeout errors.

    config MODBUS_TEMP_MAX_CONSECUTIVE_ERRORS
        int "Max consecutive read errors before alarm"
        default 10
        range 3 100

    endif # MODBUS_TEMP_ENABLED

endmenu
```

## components/nextion_hmi/Kconfig
```kconfig
menu "Nextion HMI"

config NEXTION_HMI_ENABLED
    bool "Enable Nextion HMI"
    default y

if NEXTION_HMI_ENABLED

    # ─── Transport (UART) ─────────────────────────────────────────────
    rsource "src/transport/Kconfig"

    # ─── Display / UI ─────────────────────────────────────────────────
    rsource "src/ui/Kconfig"

    # ─── Program data (editor, limits, validation) ────────────────────
    rsource "src/program/Kconfig"

    # ─── SD-card storage & file I/O ───────────────────────────────────
    rsource "src/storage/Kconfig"

    # ─── Event dispatcher tasks ───────────────────────────────────────
    rsource "src/events/Kconfig"

    # ─── HMI coordinator (command queue + worker task) ────────────────
    rsource "src/coordinator/Kconfig"

    # ─── Core / entry-point tasks ─────────────────────────────────────

    menu "Core Task Configuration"

        config NEXTION_RX_TASK_STACK_SIZE
            int "RX task stack size (bytes)"
            default 4096

        config NEXTION_RX_TASK_PRIORITY
            int "RX task priority"
            default 10

        config NEXTION_RX_COMPONENT_ID
            int "Nextion RX Component ID"
            default 6
            help
                Unique identifier for the Nextion RX task used by the health monitor.

        config NEXTION_RX_HEARTBEAT_TIMEOUT_MS
            int "Nextion RX Heartbeat Timeout (ms)"
            default 5000
            help
                Maximum time between heartbeats for the Nextion RX task.

    endmenu

endif # NEXTION_HMI_ENABLED

endmenu
```

## components/nextion_hmi/src/coordinator/Kconfig
```kconfig
menu "HMI Coordinator Task"

    config NEXTION_COORDINATOR_TASK_STACK_SIZE
        int "Coordinator task stack size (bytes)"
        default 8192
        help
            Stack size for the single HMI coordinator task that processes
            all commands sequentially (line handling, file I/O, display
            updates). Must be large enough for the deepest call chain
            (typically program load with graph building).

    config NEXTION_COORDINATOR_TASK_PRIORITY
        int "Coordinator task priority"
        default 5

    config NEXTION_COORDINATOR_QUEUE_DEPTH
        int "Command queue depth"
        default 8
        help
            Maximum number of commands that can be queued before the
            coordinator processes them. Commands arrive at human
            interaction speed, so a small queue is sufficient.

    config NEXTION_COORDINATOR_COMPONENT_ID
        int "HMI Coordinator Component ID"
        default 5
        help
            Unique identifier for the HMI Coordinator task used by the health monitor.

    config NEXTION_COORDINATOR_HEARTBEAT_TIMEOUT_MS
        int "HMI Coordinator Heartbeat Timeout (ms)"
        default 5000
        help
            Maximum time between heartbeats for the HMI coordinator task.

endmenu
```
