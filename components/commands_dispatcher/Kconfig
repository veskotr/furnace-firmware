## components/nextion_hmi/src/events/Kconfig
```kconfig
menu "Event Dispatcher Configuration"
    # Note: The per-operation task configs (sync, save, edit, load) have been
    # removed. All event handling now runs on the single HMI coordinator task.
    # See src/coordinator/Kconfig for the coordinator task settings.
endmenu
```

## components/nextion_hmi/src/program/Kconfig
```kconfig
menu "Program Editor"

    config NEXTION_PROGRAMS_PAGE_STAGE_COUNT
        int "Stages displayed per page"
        default 5
        help
            Number of stage rows visible on each programs editor page.

    config NEXTION_PROGRAMS_PAGE_COUNT
        int "Number of editor pages"
        default 3
        help
            Number of pages in the programs editor.
            Total stages = page_stage_count * page_count.

endmenu

menu "Operational Limits"

    config NEXTION_MAX_OPERATIONAL_TIME_MIN
        int "Maximum total program time (minutes)"
        default 10080
        help
            Upper bound for total program duration. 10080 = 7 days.

    config NEXTION_MIN_OPERATIONAL_TIME_MIN
        int "Minimum total program time (minutes)"
        default 1

    config NEXTION_MAX_TEMPERATURE_C
        int "Maximum temperature (C)"
        default 170

    config NEXTION_SENSOR_READ_FREQUENCY_SEC
        int "Sensor read frequency (seconds)"
        default 1

    config NEXTION_DELTA_T_MAX_PER_MIN_X10
        int "Max heating rate x10 (30 = 3.0 C/min)"
        default 30

    config NEXTION_DELTA_T_MIN_PER_MIN_X10
        int "Max cooling rate x10 (-30 = -3.0 C/min)"
        default -30

    config NEXTION_T_DELTA_MIN_MIN
        int "Minimum time delta per stage (minutes)"
        default 1

    config NEXTION_HEATER_POWER_KW
        int "Heater power (kW)"
        default 20

endmenu

menu "Validation Tolerances"

    config NEXTION_TIME_TOLERANCE_SEC
        int "Time tolerance (seconds)"
        default 30
        help
            Allowed deviation when checking if user-entered time
            is physically achievable.

    config NEXTION_TEMP_TOLERANCE_C
        int "Temperature tolerance (C)"
        default 2

    config NEXTION_DELTA_TEMP_TOLERANCE_C_X10
        int "Delta-temp tolerance x10 (5 = 0.5 C/min)"
        default 5

endmenu
```

## components/nextion_hmi/src/storage/Kconfig
```kconfig
menu "Program Storage"

    config NEXTION_MAX_PROGRAMS
        int "Maximum number of stored programs"
        default 200

    config NEXTION_PROGRAM_FILE_SIZE
        int "Program file buffer size (bytes)"
        default 4096
        help
            Maximum buffer size for program file read/write.
            Nextion SD bus limit is 4 KB.

    config NEXTION_PROGRAM_FILE_EXTENSION
        string "Program file extension"
        default ".prg"

    config NEXTION_FILE_READ_CHUNK_SIZE
        int "File read chunk size (bytes)"
        default 512
        help
            Chunk size for reading files from Nextion SD card.

    config NEXTION_FILE_WRITE_CHUNK_SIZE
        int "File write chunk size (bytes)"
        default 512
        help
            Chunk size for writing files to Nextion SD card via twfile.

    config NEXTION_HMI_PROFILE_SLOT_COUNT
        int "Heating profile slot count"
        default 1

endmenu
```

## components/nextion_hmi/src/transport/Kconfig
```kconfig
menu "UART Configuration"

    config NEXTION_UART_PORT_NUM
        int "UART port number (0, 1 or 2)"
        default 1
        range 0 2
        help
            Hardware UART peripheral to use for Nextion communication.
            0 = UART0, 1 = UART1, 2 = UART2.

    config NEXTION_UART_BAUD_RATE
        int "UART baud rate"
        default 115200
        help
            Baud rate for Nextion UART communication.
            Must match the baud rate configured on the Nextion display.

    config NEXTION_UART_TX_PIN
        int "UART TX GPIO pin"
        default 32

    config NEXTION_UART_RX_PIN
        int "UART RX GPIO pin"
        default 33

    config NEXTION_UART_RX_BUF_SIZE
        int "UART RX buffer size (bytes)"
        default 2048

    config NEXTION_UART_TX_BUF_SIZE
        int "UART TX buffer size (bytes)"
        default 2048

    config NEXTION_LINE_BUF_SIZE
        int "Line buffer size for RX parsing (bytes)"
        default 128
        help
            Maximum length of a single Nextion command/response line.

    config NEXTION_UART_RESPONSE_TIMEOUT_MS
        int "UART response timeout (ms)"
        default 2000
        help
            Timeout waiting for a response from the Nextion display
            for file operations and write-file commands.

    config NEXTION_UART_PACKET_ACK_TIMEOUT_MS
        int "UART packet ACK timeout (ms)"
        default 500
        help
            Timeout waiting for per-packet acknowledgement during
            file write (twfile) transfers.

endmenu
```

## components/nextion_hmi/src/ui/Kconfig
```kconfig
menu "Display Configuration"

    config NEXTION_MAIN_GRAPH_WIDTH
        int "Main page graph width (px)"
        default 1024

    config NEXTION_MAIN_GRAPH_HEIGHT
        int "Main page graph height (px)"
        default 321

    config NEXTION_PROGRAMS_GRAPH_WIDTH
        int "Programs page graph width (px)"
        default 1024

    config NEXTION_PROGRAMS_GRAPH_HEIGHT
        int "Programs page graph height (px)"
        default 450

    config NEXTION_GRAPH_DISP_ID
        int "Main graph Nextion component ID"
        default 6
        help
            The object ID of the waveform component on the main page.

    config NEXTION_PROGRAMS_GRAPH_ID
        int "Programs graph Nextion component ID"
        default 51
        help
            The object ID of the waveform component on the programs page.

    config NEXTION_PAGE_MAIN
        string "Main page name"
        default "main_page"
        help
            Must match the page name in the Nextion HMI project.

    config NEXTION_PAGE_PROGRAMS
        string "Programs page name"
        default "programs_page"

    config NEXTION_PAGE_SETTINGS
        string "Settings page name"
        default "settings_page"

endmenu
```

## components/spi_master_component/Kconfig
```kconfig
 menu "SPI"

    menu "Bus Settings"
        config SPI_BUS_MISO
            int "MISO pin"
            default 12

        config SPI_BUS_MOSI
            int "MOSI pin"
            default 13

        config SPI_BUS_SCK
            int "SCK pin"
            default 14

        config SPI_BUS_MODE
            int "SPI mode (0–3)"
            default 0
            range 0 3

        config SPI_CLOCK_SPEED_HZ
            int "Clock speed (Hz)"
            default 50000

        config SPI_TRANSACTION_TIMEOUT_MS
            int "Transaction timeout (ms)"
            default 1000

        config SPI_MAX_NUM_SLAVES
            int "Max number of slave devices"
            default 1
            range 1 9
        
        config SPI_MAX_TRANSFER_SIZE
            int "Max transfer size (bytes)"
            default 64
    endmenu

    menu "Slave CS Pins"
        config SPI_SLAVE1_CS
            int "Slave 1 CS pin"
            default 15

        config SPI_SLAVE2_CS
            int "Slave 2 CS pin"
            default 4

        config SPI_SLAVE3_CS
            int "Slave 3 CS pin"
            default 5

        config SPI_SLAVE4_CS
            int "Slave 4 CS pin"
            default 16

        config SPI_SLAVE5_CS
            int "Slave 5 CS pin"
            default 17

        config SPI_SLAVE6_CS
            int "Slave 6 CS pin"
            default 18

        config SPI_SLAVE7_CS
            int "Slave 7 CS pin"
            default 19

        config SPI_SLAVE8_CS
            int "Slave 8 CS pin"
            default 21

        config SPI_SLAVE9_CS
            int "Slave 9 CS pin"
            default 22
    endmenu

endmenu
```

## components/temp_sensor_device/Kconfig
```kconfig
menu "Temperature Sensor Device Configuration"

    config TEMP_SENSOR_DEVICE_MAX_DEVICES
        int "Maximum number of temperature sensor devices"
        default 16
        help
            Maximum number of temperature sensor devices that can be registered with the Device Manager.
            This limits the size of the internal device registry for temperature sensors and affects memory usage.

    config TEMP_SENSOR_MODBUS_START_ADDRESS
        int "Modbus start address for temperature sensor devices"
        default 1
        help
            Starting Modbus register address for temperature sensor devices. Each device will be assigned a unique address starting from this value.

endmenu
```

## components/temperature_monitor_component/Kconfig
```kconfig
menu "Temperature Sensors"

    config TEMP_MONITOR_TASK_STACK_SIZE
         int "Temperature monitor task stack size"
         default 4096

    config TEMP_MONITOR_TASK_PRIORITY
        int "Temperature monitor task priority"
        default 5

    config TEMP_MONITOR_TASK_NAME
        string "Temperature monitor task name"
        default "TEMP_MONITOR_TASK"

    config TEMP_SENSORS_MAX_SENSORS
        int "Max number of sensors"
        default 9

    config TEMP_SENSORS_SAMPLING_FREQ_HZ
        int "Sampling frequency (Hz)"
        default 20

    config TEMP_SENSORS_MAXIMUM_BAD_SAMPLES_PER_BATCH_PERCENT
        int "Max bad samples per batch (%)"
        default 30

    config TEMP_SENSORS_RING_BUFFER_SIZE
        int "Ring buffer size"
        default 32

    config TEMP_SENSORS_MAX_SENSOR_FAILURES
        int "Max sensor failures before error"
        default 5

    menu "Sensor Read Behavior"
        config TEMP_SENSOR_MAX_READ_RETRIES
            int "Max read retries"
            default 3

        config TEMP_SENSOR_RETRY_DELAY_MS
            int "Retry delay (ms)"
            default 10

        config TEMP_SENSOR_MAX_TEMPERATURE_C
            int "Max allowed temperature (°C)"
            default 220

        config TEMP_DELTA_THRESHOLD
            int "Delta threshold ±°C"
            default 2

        config TEMP_SENSORS_HAVE_OUTLIERS_REJECTION
            bool "Enable outlier rejection"
            default y
    endmenu

endmenu
```

## components/time-component/Kconfig
```kconfig
menu "Time Component"

    config TIME_COMPONENT_TASK_STACK_SIZE
        int "Time component processor task stack size"
        default 4096

    config TIME_COMPONENT_TASK_PRIORITY
        int "Time component processor task priority"
        default 5

    config TIME_COMPONENT_TASK_NAME
        string "Time component processor task name"
        default "TIME_TASK"

endmenu
```

## main/Kconfig.projbuild
```kconfig
menu "Alarm Controller"
    config ALARM_CONTROLLER_GPIO
        int "GPIO Pin"
        default 26
endmenu
```
