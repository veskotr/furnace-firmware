## components/fan_controller_component/Kconfig
```kconfig
menu "Fan Controller"

config FAN_CONTROLLER_GPIO_PIN
    int "Fan Controller GPIO Pin"
    default 19

config FAN_CONTROLLER_AUTO_ON_C
    int "Auto-on threshold (C)"
    default 43
    help
        When no program is running, the fan turns on once the
        measured ambient/internal temperature reaches this value.

config FAN_CONTROLLER_AUTO_OFF_C
    int "Auto-off threshold (C)"
    default 40
    help
        When no program is running, the fan turns off once the
        measured temperature falls below this value. Must be
        strictly less than FAN_CONTROLLER_AUTO_ON_C to provide
        hysteresis and prevent chattering.

endmenu
```

## components/heater_controller_component/Kconfig
```kconfig
menu "Heater Controller"
    config HEATER_CONTACTOR_GPIO_PIN
        int "GPIO Pin"
        default 22

    config HEATER_SSR_GPIO_PIN
        int "GPIO Pin"
        default 21

    config FAN_CONTROL_GPIO_PIN
        int "GPIO Pin"
        default 19

    config HEATER_WINDOW_SIZE_MS
        int "Heater Window Size (ms)"
        default 10000

    config HEATER_CONTROLLER_TASK_NAME
        string "Heater Controller Task Name"
        default "heater_controller_task"

    config HEATER_CONTROLLER_TASK_STACK_SIZE
        int "Heater Controller Task Stack Size"
        default 4096

    config HEATER_CONTROLLER_TASK_PRIORITY
        int "Heater Controller Task Priority"
        default 5

    config HEATER_CONTROLLER_COMPONENT_ID
        int "Heater Controller Component ID"
        default 2
        help
            Unique identifier for the Heater Controller component used by the health monitor.

    config HEATER_CONTROLLER_HEARTBEAT_TIMEOUT_MS
        int "Heater Controller Heartbeat Timeout (ms)"
        default 15000
        help
            Maximum time between heartbeats before the health monitor considers the heater controller unhealthy.
            Should be larger than HEATER_WINDOW_SIZE_MS.

endmenu
```

## components/run_indicator/Kconfig
```kconfig
menu "Run Indicator"

config RUN_INDICATOR_ENABLED
    bool "Enable run indicator"
    default n

config RUN_INDICATOR_GPIO
    int "Run Indicator GPIO Pin"
    default -1
    depends on RUN_INDICATOR_ENABLED

endmenu
```

## components/transmitter_diagnostics/Kconfig
```kconfig
menu "Transmitter Diagnostics"

    config TRANSMITTER_DIAGNOSTICS_SCAN_START_ADDR
        int "Modbus slave scan range start"
        default 1
        range 1 247
        help
            First Modbus slave address probed when searching for the transmitter.

    config TRANSMITTER_DIAGNOSTICS_SCAN_END_ADDR
        int "Modbus slave scan range end"
        default 16
        range 1 247
        help
            Last Modbus slave address probed when searching for the transmitter.
            Keep this small for fast boot-time scans; widen if the unit can sit
            on any address.

endmenu
```
